;/*
;* Sleep Modes
;*
;* sleep.inc
;*
;*  Created: 30.12.2014 02:23:05
;*   Author: Dominik
;*/

.IFNDEF SLEEP_INCLUDE
.SET SLEEP_INCLUDE = 1

.IFNDEF SLEEP_BASE
	.SET SLEEP_BASE = 0x0048
.ENDIF

.SET SLEEP_IDEL		= (0b000<<1)
.SET SLEEP_PDOWN	= (0b010<<1)
.SET SLEEP_PSAVE	= (0b011<<1)
.SET SLEEP_STDBY	= (0b110<<1)
.SET SLEEP_ESTDBY	= (0b111<<1)
.SET SLEEP_ENABLE	= (1<<0)


;Sleep Modes
SLEEP_MODE_SET:  ; R16 = VALUE
PUSH R16
PUSH R17
	LDI R17, SLEEP_ENABLE
	EOR R17, R16
	STS SLEEP_BASE+0, R17
POP R17
POP R16
RET

SLEEP_MODE_CLR:
PUSH R16
	LDI R16, 0x00
	STS SLEEP_BASE+0, R16
POP R16
RET

.ENDIF