;/*
;* adc.inc
;*
;*  Created: 22.02.2015 16:54:59
;*   Author: Dominik
;*/ 

.IFNDEF ADC_INCLUDE
.SET ADC_INCLUDE = 1
	.IFNDEF ADCA_BASE 
		.SET ADCA_BASE = 0x0200
	.ENDIF

	.IFNDEF ADCB_BASE 
		.SET ADCB_BASE = 0x0240
	.ENDIF

	.SET ADC_CH0 = 0x20
	.SET ADC_CH1 = 0x28
	.SET ADC_CH2 = 0x30
	.SET ADC_CH3 = 0x38

	ADCA_INIT:
	PUSH R16	
		;Load CALL
		LDI R16, 0x20
		CALL NVM_READ_PSR
		STS ADCA_BASE+0x0C, R0
		;Load CALH
		LDI R16, 0x21
		CALL NVM_READ_PSR
		STS ADCA_BASE+0x0D, R0
		; Enable ADC
		LDI R16, 0x01
		STS ADCA_BASE+0x00, R16
	POP R16
	RET

	ADCB_INIT:
	PUSH R16	
		;Load CALL
		LDI R16, 0x24
		CALL NVM_READ_PSR
		STS ADCB_BASE+0x0C, R0
		;Load CALH
		LDI R16, 0x25
		CALL NVM_READ_PSR
		STS ADCB_BASE+0x0D, R0
		; Enable ADC
		LDI R16, 0x01
		STS ADCB_BASE+0x00, R16
	POP R16
	RET

	.MACRO ADCA_CH_SINGLEENDED ;(CH_NR, PIN_NR) 
	PUSH R16
		.IF @0 == 0
			LDS R16, ADCA_BASE+ADC_CH0+0
			SBR R16, 0b01 
			STS ADCA_BASE+ADC_CH0+0, R16

			LDS R16, ADCA_BASE+ADC_CH0+1
			SBR R16, @1<<3
			STS ADCA_BASE+ADC_CH0+1, R16
		.ENDIF
		.IF @0 == 1
			LDS R16, ADCA_BASE+ADC_CH1+0
			SBR R16, 0b01 
			STS ADCA_BASE+ADC_CH1+0, R16

			LDS R16, ADCA_BASE+ADC_CH1+1
			SBR R16, @1<<3
			STS ADCA_BASE+ADC_CH1+1, R16
		.ENDIF
		.IF @0 == 2
			LDS R16, ADCA_BASE+ADC_CH2+0
			SBR R16, 0b01 
			STS ADCA_BASE+ADC_CH2+0, R16

			LDS R16, ADCA_BASE+ADC_CH2+1
			SBR R16, @1<<3
			STS ADCA_BASE+ADC_CH2+1, R16
		.ENDIF
		.IF @0 == 3
			LDS R16, ADCA_BASE+ADC_CH3+0
			SBR R16, 0b01 
			STS ADCA_BASE+ADC_CH3+0, R16

			LDS R16, ADCA_BASE+ADC_CH3+1
			SBR R16, @1<<3
			STS ADCA_BASE+ADC_CH3+1, R16
		.ENDIF
	POP R16
	.ENDMACRO

	.MACRO ADCB_CH_SINGLEENDED ;(CH_NR, PIN_NR) 
	PUSH R16
		.IF @0 == 0
			LDS R16, ADCB_BASE+ADC_CH0+0
			SBR R16, 0b01 
			STS ADCB_BASE+ADC_CH0+0, R16

			LDS R16, ADCB_BASE+ADC_CH0+1
			SBR R16, @1<<3
			STS ADCB_BASE+ADC_CH0+1, R16
		.ENDIF
		.IF @0 == 1
			LDS R16, ADCB_BASE+ADC_CH1+0
			SBR R16, 0b01 
			STS ADCB_BASE+ADC_CH1+0, R16

			LDS R16, ADCB_BASE+ADC_CH1+1
			SBR R16, @1<<3
			STS ADCB_BASE+ADC_CH1+1, R16
		.ENDIF
		.IF @0 == 2
			LDS R16, ADCB_BASE+ADC_CH2+0
			SBR R16, 0b01 
			STS ADCB_BASE+ADC_CH2+0, R16

			LDS R16, ADCB_BASE+ADC_CH2+1
			SBR R16, @1<<3
			STS ADCB_BASE+ADC_CH2+1, R16
		.ENDIF
		.IF @0 == 3
			LDS R16, ADCB_BASE+ADC_CH3+0
			SBR R16, 0b01 
			STS ADCB_BASE+ADC_CH3+0, R16

			LDS R16, ADCB_BASE+ADC_CH3+1
			SBR R16, @1<<3
			STS ADCB_BASE+ADC_CH3+1, R16
		.ENDIF
	POP R16
	.ENDMACRO

	.MACRO ADCA_CLK_DIV ; (DIV )
	PUSH R16
		.IF @0 == 4
			LDI R16, 0b000
		.ELSE 
		.IF @0 == 8
			LDI R16, 0b001
		.ELSE 
		.IF @0 == 16
			LDI R16, 0b010
		.ELSE 
		.IF @0 == 32
			LDI R16, 0b011
		.ELSE 
		.IF @0 == 64
			LDI R16, 0b100
		.ELSE 
		.IF @0 == 128
			LDI R16, 0b101
		.ELSE 
		.IF @0 == 256
			LDI R16, 0b110
		.ELSE 
		.IF @0 == 512
			LDI R16, 0b111
		.ELSE
			.ERROR "ADCA_CLK_DIV wrong DIV value"
		.ENDIF
		.ENDIF
		.ENDIF
		.ENDIF
		.ENDIF
		.ENDIF
		.ENDIF
		.ENDIF
		STS ADCA_BASE+0x04, R16
	POP R16
	.ENDMACRO

	.MACRO ADCB_CLK_DIV ; (DIV )
	PUSH R16
		.IF @0 == 4
			LDI R16, 0b000
		.ELSE 
		.IF @0 == 8
			LDI R16, 0b001
		.ELSE 
		.IF @0 == 16
			LDI R16, 0b010
		.ELSE 
		.IF @0 == 32
			LDI R16, 0b011
		.ELSE 
		.IF @0 == 64
			LDI R16, 0b100
		.ELSE 
		.IF @0 == 128
			LDI R16, 0b101
		.ELSE 
		.IF @0 == 256
			LDI R16, 0b110
		.ELSE 
		.IF @0 == 512
			LDI R16, 0b111
		.ELSE
			.ERROR "ADCB_CLK_DIV wrong DIV value"
		.ENDIF
		.ENDIF
		.ENDIF
		.ENDIF
		.ENDIF
		.ENDIF
		.ENDIF
		.ENDIF
		STS ADCB_BASE+0x04, R16
	POP R16
	.ENDMACRO
.ENDIF




