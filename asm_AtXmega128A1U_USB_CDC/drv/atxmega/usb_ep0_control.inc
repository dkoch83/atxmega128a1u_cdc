;/*
; * usb_ep0_control.inc
; *
; *  Created: 21.01.2016 21:16:20
; *   Author: Dominik Koch
; */ 


.ifndef USB_EP0_CONTROL_INCLUDE
.set USB_EP0_CONTROL_INCLUDE = 1

;####################################################################################################
;
;####################################################################################################

USB_EP0_CONTROL:
PUSH XL
PUSH XH
PUSH R16
PUSH R17
PUSH R20
PUSH R21
PUSH R22
PUSH ZL
PUSH ZH
	LDI R16, 0x80
	LDI ZL, LOW(EP0_BUFFER)
	LDI ZH, HIGH(EP0_BUFFER)
	RCALL USB_EP_SET_DATAPTR ; R16 = EP | Z = Buffer

	LDS R20, bmRequestType
	ANDI R20, 0x60
	CPI R20, STANDARDREQUEST
	BREQ USB_EP0_CONTROL_STANDARDREQUEST

	RJMP USB_EP0_CONTROL_STANDARDREQUEST_end
	USB_EP0_CONTROL_STANDARDREQUEST:
		LDS R20, bRequest
		;################################################
		CPI R20, CLEAR_FEATURE
		BREQ USB_EP0_CONTROL_CLEAR_FEATURE
		RJMP USB_EP0_CONTROL_CLEAR_FEATURE_END
		USB_EP0_CONTROL_CLEAR_FEATURE:
			RCALL USB_CLEAR_FEATURE
			RJMP USB_EP0_CONTROL_END
		USB_EP0_CONTROL_CLEAR_FEATURE_END:
		;################################################
		CPI R20, GET_STATUS
		BREQ USB_EP0_CONTROL_GET_STATUS
		RJMP USB_EP0_CONTROL_GET_STATUS_END
		USB_EP0_CONTROL_GET_STATUS:
			RCALL USB_GET_STATUS
			; USB_EP0_SEND 2 Bytes
			PUSH ZL
			PUSH ZH
				CLR ZH
				LDI ZL, 0x02
				RCALL USB_EP0_SEND ; Z = Size
			POP ZH
			POP ZL
			RJMP USB_EP0_CONTROL_END
		USB_EP0_CONTROL_GET_STATUS_END:
		;################################################
		CPI R20, SET_ADDRESS
		BREQ USB_EP0_CONTROL_SET_ADDRESS
		RJMP USB_EP0_CONTROL_SET_ADDRESS_END
		USB_EP0_CONTROL_SET_ADDRESS:
			LDI R16, 0x00
			LDI R17, (USB_EP_BUSNACK0_bm | USB_EP_TRNCOMPL0_bm)
			RCALL USB_EP_CLEAR_STATUS ; R16 = EP, R17 = MASK
			; Send ZLP
			CLR ZL
			CLR ZH
			RCALL USB_EP0_SEND ; Z = Size
			; Set New Address
			LDS R21, wValueL
			ANDI R21, 0b01111111
			STS USB_ADDR, R21
		RJMP USB_EP0_CONTROL_END
		USB_EP0_CONTROL_SET_ADDRESS_END:
		;################################################
		CPI R20, GET_DESCRIPTOR
		BREQ USB_EP0_CONTROL_GET_DESCRIPTOR
		RJMP USB_EP0_CONTROL_GET_DESCRIPTOR_END
		USB_EP0_CONTROL_GET_DESCRIPTOR:
			LDS R21, wValueH
			LDS R22, wValueL

			CPI R21, DEVICE_DESCRIPTOR
			BREQ USB_EP0_CONTROL_GET_DESCRIPTOR_DEVICE_DESCRIPTOR
			RJMP USB_EP0_CONTROL_GET_DESCRIPTOR_DEVICE_DESCRIPTOR_END
			USB_EP0_CONTROL_GET_DESCRIPTOR_DEVICE_DESCRIPTOR:
				LDI ZL, LOW(DEV_DES)
				LDI ZH, HIGH(DEV_DES)

				LDI XL, 0x12 
				LDI XH, 0x00
				RCALL USB_EP0_SEND_DESCRIPTOR ; Z = Pointer Descriptor | X = Descriptor Size 

				RJMP USB_EP0_CONTROL_END
			USB_EP0_CONTROL_GET_DESCRIPTOR_DEVICE_DESCRIPTOR_END:
			;################################################
			CPI R21, CONFIG_DESCRIPTOR
			BREQ USB_EP0_CONTROL_GET_DESCRIPTOR_CONFIG_DESCRIPTOR
			RJMP USB_EP0_CONTROL_GET_DESCRIPTOR_CONFIG_DESCRIPTOR_END
			USB_EP0_CONTROL_GET_DESCRIPTOR_CONFIG_DESCRIPTOR:
				LDI ZL, LOW(CONF_DES) 
				LDI ZH, HIGH(CONF_DES)

				LDI XL, LOW(67) 
				LDI XH, HIGH(67)
				RCALL USB_EP0_SEND_DESCRIPTOR ; Z = Pointer Descriptor | X = Descriptor Size 

				RJMP USB_EP0_CONTROL_END
			USB_EP0_CONTROL_GET_DESCRIPTOR_CONFIG_DESCRIPTOR_END:
			;################################################
			CPI R21, STRING_DESCRIPTOR
			BREQ USB_EP0_CONTROL_GET_DESCRIPTOR_STRING_DESCRIPTOR
			RJMP USB_EP0_CONTROL_GET_DESCRIPTOR_STRING_DESCRIPTOR_END
			USB_EP0_CONTROL_GET_DESCRIPTOR_STRING_DESCRIPTOR:
				CPI R22, 0x00 ; Index 0
				BREQ USB_EP0_CONTROL_GET_DESCRIPTOR_STRING_DESCRIPTOR0
				RJMP USB_EP0_CONTROL_GET_DESCRIPTOR_STRING_DESCRIPTOR0_END
				USB_EP0_CONTROL_GET_DESCRIPTOR_STRING_DESCRIPTOR0:
					LDI ZL, LOW(LANG_DES) 
					LDI ZH, HIGH(LANG_DES)

					LDI XL, LOW(LANG_DES_LEN) 
					LDI XH, HIGH(LANG_DES_LEN)
					RCALL USB_EP0_SEND_DESCRIPTOR ; Z = Pointer Descriptor | X = Descriptor Size 
				
					RJMP USB_EP0_CONTROL_END
				USB_EP0_CONTROL_GET_DESCRIPTOR_STRING_DESCRIPTOR0_END:
				;################################################
				CPI R22, 0x01 ; Index 1
				BREQ USB_EP0_CONTROL_GET_DESCRIPTOR_STRING_DESCRIPTOR1
				RJMP USB_EP0_CONTROL_GET_DESCRIPTOR_STRING_DESCRIPTOR1_END
				USB_EP0_CONTROL_GET_DESCRIPTOR_STRING_DESCRIPTOR1:
					LDI ZL, LOW(STRING_DES_1) 
					LDI ZH, HIGH(STRING_DES_1)

					LDI XL, LOW(STRING_DES_1_LEN) 
					LDI XH, HIGH(STRING_DES_1_LEN)
					RCALL USB_EP0_SEND_DESCRIPTOR ; Z = Pointer Descriptor | X = Descriptor Size 
				
					RJMP USB_EP0_CONTROL_END
				USB_EP0_CONTROL_GET_DESCRIPTOR_STRING_DESCRIPTOR1_END:
				;################################################
				CPI R22, 0x02 ; Index 2
				BREQ USB_EP0_CONTROL_GET_DESCRIPTOR_STRING_DESCRIPTOR2
				RJMP USB_EP0_CONTROL_GET_DESCRIPTOR_STRING_DESCRIPTOR2_END
				USB_EP0_CONTROL_GET_DESCRIPTOR_STRING_DESCRIPTOR2:
					LDI ZL, LOW(STRING_DES_2) 
					LDI ZH, HIGH(STRING_DES_2)

					LDI XL, LOW(STRING_DES_2_LEN) 
					LDI XH, HIGH(STRING_DES_2_LEN)
					RCALL USB_EP0_SEND_DESCRIPTOR ; Z = Pointer Descriptor | X = Descriptor Size 
				
					RJMP USB_EP0_CONTROL_END
				USB_EP0_CONTROL_GET_DESCRIPTOR_STRING_DESCRIPTOR2_END:
				;################################################
				CPI R22, 0x03 ; Index 3
				BREQ USB_EP0_CONTROL_GET_DESCRIPTOR_STRING_DESCRIPTOR3
				RJMP USB_EP0_CONTROL_GET_DESCRIPTOR_STRING_DESCRIPTOR3_END
				USB_EP0_CONTROL_GET_DESCRIPTOR_STRING_DESCRIPTOR3:
					LDI ZL, LOW(STRING_DES_3) 
					LDI ZH, HIGH(STRING_DES_3)

					LDI XL, LOW(STRING_DES_3_LEN) 
					LDI XH, HIGH(STRING_DES_3_LEN)
					RCALL USB_EP0_SEND_DESCRIPTOR ; Z = Pointer Descriptor | X = Descriptor Size 
				
					RJMP USB_EP0_CONTROL_END
				USB_EP0_CONTROL_GET_DESCRIPTOR_STRING_DESCRIPTOR3_END:
			USB_EP0_CONTROL_GET_DESCRIPTOR_STRING_DESCRIPTOR_END:
		USB_EP0_CONTROL_GET_DESCRIPTOR_END:
		;################################################
		CPI R20, SET_CONFIGURATION
		BREQ USB_EP0_CONTROL_SET_CONFIGURATION
		RJMP USB_EP0_CONTROL_SET_CONFIGURATION_END
		USB_EP0_CONTROL_SET_CONFIGURATION:
			LDS R16, wValueL
			STS USB_CONFIG, R16
			RCALL USB_SET_CONFIGURATION
			CLR ZH
			LDI ZL, 0
			RCALL USB_EP0_SEND ; Z = Size
			RJMP USB_EP0_CONTROL_END
		USB_EP0_CONTROL_SET_CONFIGURATION_END:
		;################################################
		CPI R20, GET_CONFIGURATION
		BREQ USB_EP0_CONTROL_GET_CONFIGURATION
		RJMP USB_EP0_CONTROL_GET_CONFIGURATION_END
		USB_EP0_CONTROL_GET_CONFIGURATION:
			;LDI R16, bmRequestType
			;ANDI R16, 0b10000000
			LDS R16, USB_CONFIG
			STS EP0_BUFFER+0, R16
			CLR ZH
			LDI ZL, 1
			RCALL USB_EP0_SEND ; Z = Size
			RJMP USB_EP0_CONTROL_END
		USB_EP0_CONTROL_GET_CONFIGURATION_END:
		;################################################
		CPI R20, SET_DESCRIPTOR
		BREQ USB_EP0_CONTROL_SET_DESCRIPTOR
		RJMP USB_EP0_CONTROL_SET_DESCRIPTOR_END
		USB_EP0_CONTROL_SET_DESCRIPTOR:
			RJMP USB_EP0_CONTROL_STALL
		USB_EP0_CONTROL_SET_DESCRIPTOR_END:
		;################################################
		CPI R20, GET_INTERFACE
		BREQ USB_EP0_CONTROL_GET_INTERFACE
		RJMP USB_EP0_CONTROL_GET_INTERFACE_END
		USB_EP0_CONTROL_GET_INTERFACE:
			LDI XL, LOW(USB_INTERF_ALT_CONF)
			LDI XH, HIGH(USB_INTERF_ALT_CONF)

			LDS R16, wIndexL
			ADD XL, R16
			CLR R16
			ADC XH, R16

			LD R16, X
			STS EP0_BUFFER, R16

			CLR ZH
			LDI ZL, 0x01
			RCALL USB_EP0_SEND ; Z = Size
			RJMP USB_EP0_CONTROL_END
		USB_EP0_CONTROL_GET_INTERFACE_END:
		;################################################
		CPI R20, SET_INTERFACE
		BREQ USB_EP0_CONTROL_SET_INTERFACE
		RJMP USB_EP0_CONTROL_SET_INTERFACE_END
		USB_EP0_CONTROL_SET_INTERFACE:
			LDS R16, wValueL ; Interface-conf-ID 
			LDS R17, wIndexL ; Interface-ID

			LDI XL, LOW(USB_INTERF_ALT_CONF)
			LDI XH, HIGH(USB_INTERF_ALT_CONF)
			ADD XL, R17
			CLR R17
			ADC XH, R17

			ST X, R16
			LDS R16, wIndexL ; Interface-ID
			STS USB_INTERF_ALT_CONF, R16
			RCALL USB_SET_INTERFACE
			CLR ZH
			CLR ZL
			RCALL USB_EP0_SEND ; Z = Size
			RJMP USB_EP0_CONTROL_END
		USB_EP0_CONTROL_SET_INTERFACE_END:
		;################################################
		CPI R20, SET_FEATURE 
		BREQ USB_EP0_CONTROL_SET_FEATURE 
		RJMP USB_EP0_CONTROL_SET_FEATURE_END
		USB_EP0_CONTROL_SET_FEATURE:
			RCALL USB_SET_FEATURE
			RJMP USB_EP0_CONTROL_END
		USB_EP0_CONTROL_SET_FEATURE_END:
		;################################################
		USB_EP0_CONTROL_ELSE:
			RJMP USB_EP0_CONTROL_STALL
		USB_EP0_CONTROL_ELSE_END:
		;################################################
	USB_EP0_CONTROL_STANDARDREQUEST_end:
	;################################################

	LDS R20, bmRequestType
	ANDI R20, 0x60
	CPI R20, CLASSREQUEST
	BREQ USB_EP0_CONTROL_CLASSREQUEST

	RJMP USB_EP0_CONTROL_CLASSREQUEST_END
	USB_EP0_CONTROL_CLASSREQUEST:
	LDS R20, bRequest
		;################################################
.ifdef USB_CDC_INCLUDE
		;################################################
		CPI R20, SEND_ENCAPSULATED_COMMAND
		BREQ USB_EP0_CONTROL_SEND_ENCAPSULATED_COMMAND
		RJMP USB_EP0_CONTROL_SEND_ENCAPSULATED_COMMAND_END
		USB_EP0_CONTROL_SEND_ENCAPSULATED_COMMAND:
			;CALL USB_CDC_SEND_ENCAPSULATED_COMMAND
			;RJMP USB_EP0_CONTROL_END
			RJMP USB_EP0_CONTROL_STALL
		USB_EP0_CONTROL_SEND_ENCAPSULATED_COMMAND_END:
		;################################################
		CPI R20, GET_ENCAPSULATED_RESPONSE
		BREQ USB_EP0_CONTROL_GET_ENCAPSULATED_RESPONSE
		RJMP USB_EP0_CONTROL_GET_ENCAPSULATED_RESPONSE_END
		USB_EP0_CONTROL_GET_ENCAPSULATED_RESPONSE:
			;CALL USB_CDC_GET_ENCAPSULATED_RESPONSE
			;RJMP USB_EP0_CONTROL_END
			RJMP USB_EP0_CONTROL_STALL
		USB_EP0_CONTROL_GET_ENCAPSULATED_RESPONSE_END:
		;################################################
		CPI R20, SET_LINE_CODING
		BREQ USB_EP0_CONTROL_SET_LINE_CODING 
		RJMP USB_EP0_CONTROL_SET_LINE_CODING_END
		USB_EP0_CONTROL_SET_LINE_CODING:
			RCALL USB_CDC_SET_LINE_CODING
			RJMP USB_EP0_CONTROL_END
		USB_EP0_CONTROL_SET_LINE_CODING_END:
		;################################################
		CPI R20, GET_LINE_CODING
		BREQ USB_EP0_CONTROL_GET_LINE_CODING 
		RJMP USB_EP0_CONTROL_GET_LINE_CODING_END
		USB_EP0_CONTROL_GET_LINE_CODING:
			RCALL USB_CDC_GET_LINE_CODING
			RJMP USB_EP0_CONTROL_END
		USB_EP0_CONTROL_GET_LINE_CODING_END:
		;################################################
		CPI R20, SET_CONTROL_LINE_STATE
		BREQ USB_EP0_CONTROL_SET_CONTROL_LINE_STATE
		RJMP USB_EP0_CONTROL_SET_CONTROL_LINE_STATE_END
		USB_EP0_CONTROL_SET_CONTROL_LINE_STATE:
			; Send ZLP
			CLR ZL
			CLR ZH
			RCALL USB_EP0_SEND ; Z = Size				

			RJMP USB_EP0_CONTROL_END
		USB_EP0_CONTROL_SET_CONTROL_LINE_STATE_END:
.endif
		;################################################
	USB_EP0_CONTROL_CLASSREQUEST_END:
	;################################################

USB_EP0_CONTROL_STALL:
	LDI R16, 0x80
	RCALL USB_EP_STALL
	RCALL USB_EP_CLEAR_STALL
USB_EP0_CONTROL_END:
POP ZH
POP ZL
POP R22
POP R21
POP R20
POP R17
POP R16
POP XH
POP XL
RET


;####################################################################################################
;
;####################################################################################################

USB_GET_STATUS:
PUSH R20
PUSH R18
	LDS R20, bmRequestType
	ANDI R20, 0b00011111
	;#############################
	CPI R20, RequestType_DEVICE
	BREQ USB_GET_STATUS_DEVICE
	RJMP USB_GET_STATUS_DEVICE_END
	USB_GET_STATUS_DEVICE:
		CLR R18
		SBR R18, (0<<0) ; Bus Powered
		;SBR R18, (1<<0) ; Self Powered
		.IF USB_REMOTE_WAKEUP == 0
			SBR R18, (0<<1) ; No Remote Wakeup
		.ELSE 
			LDI R18, (1<<1) ; Remote Wakeup
		.ENDIF
		STS EP0_BUFFER+0, R18
		CLR R18
		STS EP0_BUFFER+1, R18
		RJMP USB_GET_STATUS_END
	USB_GET_STATUS_DEVICE_END:
	;#############################
	CPI R20, RequestType_INTERFACE
	BREQ USB_GET_STATUS_INTERFACE
	RJMP USB_GET_STATUS_INTERFACE_END
	USB_GET_STATUS_INTERFACE:
		CLR R18
		STS EP0_BUFFER+0, R18
		STS EP0_BUFFER+1, R18
		RJMP USB_GET_STATUS_END
	USB_GET_STATUS_INTERFACE_END:
	;#############################
	CPI R20, RequestType_ENDPOINT
	BREQ USB_GET_STATUS_ENDPOINT
	RJMP USB_GET_STATUS_ENDPOINT_END
	USB_GET_STATUS_ENDPOINT:
		PUSH R16
		PUSH R17
			LDS R16, wIndexL
			RCALL USB_EP_GET_STATUS ; R16 = EP | RETURN R17
			CLR R18
			STS EP0_BUFFER+1, R18
			SBRC R17, 7
			LDI R18, 0x01 ; STALLED
			STS EP0_BUFFER+0, R18
		POP R17
		POP R16
		RJMP USB_GET_STATUS_END
	USB_GET_STATUS_ENDPOINT_END:
	;#############################
	CPI R20, RequestType_OTHER
	BREQ USB_GET_STATUS_OTHER
	RJMP USB_GET_STATUS_OTHER_END
	USB_GET_STATUS_OTHER:
		CLR R18
		STS EP0_BUFFER+0, R18
		STS EP0_BUFFER+1, R18
		RJMP USB_GET_STATUS_END
	USB_GET_STATUS_OTHER_END:
	;#############################
USB_GET_STATUS_END:
POP R18
POP R20
RET


;####################################################################################################
;
;####################################################################################################

USB_SET_CONFIGURATION:
PUSH R16
PUSH R17
PUSH R18
PUSH XL
PUSH XH
	LDS R16, wValueL
	STS USB_CONFIG, R16
	
.IF USB_CDC_ENABLE == 1
	CPI R16, USB_CDC_CONFIGURATION_NUM
	BREQ USB_SET_CONFIGURATION_1
	RJMP USB_SET_CONFIGURATION_1_END
	USB_SET_CONFIGURATION_1:
		; EP_CDC_C_IN Setup
		LDI R16, EP_CDC_C_IN
		LDI R17, EP_INTERRUPT
		LDI ZL, LOW(EP_CDC_C_SIZE)
		LDI ZH, HIGH(EP_CDC_C_SIZE)
		LDI XL, LOW(EP0_BUFFER)
		LDI XH, HIGH(EP0_BUFFER)
		RCALL USB_EP_SETUP ; R16 = EP_Nummer, R17 = ep_type, R18 = ep_size, X = ep_Buffer
	
		; EP_CDC_D_OUT Setup
		LDI R16, EP_CDC_D_OUT
		LDI R17, EP_BULK
		LDI ZL, LOW(EP_CDC_D_SIZE)
		LDI ZH, HIGH(EP_CDC_D_SIZE)
		LDI XL, LOW(CDC_OUT_BUFFER)
		LDI XH, HIGH(CDC_OUT_BUFFER)
		RCALL USB_EP_SETUP ; R16 = EP_Nummer, R17 = ep_type, R18 = ep_size, X = ep_Buffer

		; EP_CDC_D_IN Setup
		LDI R16, EP_CDC_D_IN
		LDI R17, EP_BULK
		LDI ZL, LOW(EP_CDC_D_SIZE)
		LDI ZH, HIGH(EP_CDC_D_SIZE)
		LDI XL, LOW(CDC_DATA)
		LDI XH, HIGH(CDC_DATA)
		RCALL USB_EP_SETUP ; R16 = EP_Nummer, R17 = ep_type, R18 = ep_size, X = ep_Buffer
	RJMP USB_SET_CONFIGURATION_END
	USB_SET_CONFIGURATION_1_END:
.ENDIF

USB_SET_CONFIGURATION_END:
POP XH
POP XL
POP R18
POP R17
POP R16
RET


;####################################################################################################
;
;####################################################################################################

USB_SET_INTERFACE: ; R16 =  Interface-ID 

USB_SET_INTERFACE_END:
RET


;####################################################################################################
;
;####################################################################################################

USB_SET_FEATURE:
PUSH R16
PUSH R20
PUSH R21
	
	LDS R20, bmRequestType
	LDS R21, wValueL
	ANDI R20, 0b00011111
	;#############################
	CPI R20, RequestType_DEVICE
	BREQ USB_SET_FEATURE_DEVICE
	RJMP USB_SET_FEATURE_DEVICE_END
	USB_SET_FEATURE_DEVICE:
		CPI R21, 1
		BREQ USB_SET_FEATURE_DEVICE_REMOTE_WAKEUP
		RJMP USB_SET_FEATURE_DEVICE_REMOTE_WAKEUP_END
		USB_SET_FEATURE_DEVICE_REMOTE_WAKEUP:

			;RJMP USB_SET_FEATURE_END
		USB_SET_FEATURE_DEVICE_REMOTE_WAKEUP_END:
		LDI R16, 0x80
		RJMP USB_SET_FEATURE_STALL
	USB_SET_FEATURE_DEVICE_END:
	;#############################
	CPI R20, RequestType_INTERFACE
	RJMP USB_SET_FEATURE_INTERFACE_END
	USB_SET_FEATURE_INTERFACE:
		LDI R16, 0x80
		RJMP USB_SET_FEATURE_STALL
	USB_SET_FEATURE_INTERFACE_END:
	;#############################
	CPI R20, RequestType_ENDPOINT
	RJMP USB_SET_FEATURE_ENDPOINT_END
	USB_SET_FEATURE_ENDPOINT:
		CPI R21, 0
		BREQ USB_SET_FEATURE_ENDPOINT_HALT
		RJMP USB_SET_FEATURE_ENDPOINT_HALT_END
		USB_SET_FEATURE_ENDPOINT_HALT:
			PUSH R17
				LDS R16, wIndexL
				RCALL USB_EP_STALL
			POP R17
			RJMP USB_SET_FEATURE_END
		USB_SET_FEATURE_ENDPOINT_HALT_END:
		LDI R16, 0x80
		RJMP USB_SET_FEATURE_STALL
	USB_SET_FEATURE_ENDPOINT_END:

	RJMP USB_SET_FEATURE_STALL_END
	USB_SET_FEATURE_STALL:
		RCALL USB_EP_STALL
		RCALL USB_EP_CLEAR_STALL
	USB_SET_FEATURE_STALL_END:

USB_SET_FEATURE_END:
POP R21
POP R20
POP R16
RET


;####################################################################################################
;
;####################################################################################################

USB_CLEAR_FEATURE:
PUSH R16
PUSH R20
PUSH R21
	LDS R20, bmRequestType
	LDS R21, wValueL
	ANDI R20, 0b00011111
	;#############################
	CPI R20, RequestType_DEVICE
	BREQ USB_CLEAR_FEATURE_DEVICE
	RJMP USB_CLEAR_FEATURE_DEVICE_END
	USB_CLEAR_FEATURE_DEVICE:
		CPI R21, 1
		BREQ USB_CLEAR_FEATURE_DEVICE_REMOTE_WAKEUP
		RJMP USB_CLEAR_FEATURE_DEVICE_REMOTE_WAKEUP_END
		USB_CLEAR_FEATURE_DEVICE_REMOTE_WAKEUP:
			;RJMP USB_CLEAR_FEATURE_END
		USB_CLEAR_FEATURE_DEVICE_REMOTE_WAKEUP_END:
		LDI R16, 0x80
		RJMP USB_CLEAR_FEATURE_STALL
	USB_CLEAR_FEATURE_DEVICE_END:
	;#############################
	CPI R20, RequestType_INTERFACE
	RJMP USB_CLEAR_FEATURE_INTERFACE_END
	USB_CLEAR_FEATURE_INTERFACE:
		LDI R16, 0x80
		RJMP USB_CLEAR_FEATURE_STALL
	USB_CLEAR_FEATURE_INTERFACE_END:
	;#############################
	CPI R20, RequestType_ENDPOINT
	RJMP USB_SET_FEATURE_ENDPOINT_END
	USB_CLEAR_FEATURE_ENDPOINT:
		CPI R21, 0
		BREQ USB_CLEAR_FEATURE_ENDPOINT_HALT
		RJMP USB_CLEAR_FEATURE_ENDPOINT_HALT_END
		USB_CLEAR_FEATURE_ENDPOINT_HALT:
			PUSH R17
				LDS R16, wIndexL
				RCALL USB_EP_GET_CTRL ; R16 = EP | RETURN R17
				CBR R17, USB_EP_STALL_bm
				RCALL USB_EP_SET_CTRL ; R16 = EP | R17 = CTRL
				
				RCALL USB_EP_GET_STATUS ; R16 = EP, R17 = MASK
				LDI R17, (USB_EP_STALLF_bm | USB_EP_UNF_bm | USB_EP_SETUP_bm | USB_EP_BANK_bm | USB_EP_BUSNACK1_bm | USB_EP_TOGGLE_bm)
				RCALL USB_EP_SET_STATUS ; R16 = EP, R17 = MASK
			POP R17
			RJMP USB_SET_FEATURE_END
		USB_CLEAR_FEATURE_ENDPOINT_HALT_END:
		LDI R16, 0x80
		RJMP USB_CLEAR_FEATURE_STALL
	USB_CLEAR_FEATURE_ENDPOINT_END:

	RJMP USB_CLEAR_FEATURE_STALL_END
	USB_CLEAR_FEATURE_STALL:
		RCALL USB_EP_STALL
		RCALL USB_EP_CLEAR_STALL
	USB_CLEAR_FEATURE_STALL_END:

USB_CLEAR_FEATURE_END:
POP R21
POP R20
POP R16
RET



.ENDIF
