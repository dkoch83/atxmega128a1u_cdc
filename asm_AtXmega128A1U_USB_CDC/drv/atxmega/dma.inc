;/*
; * dma.inc
; *
; *  Created: 03.11.2015 20:03:01
; *   Author: domin
; */ 
 .ifndef dma_include
	.set dma_include = 1

; 	.IFNDEF DMA_BASE
;		.EQU DMA_BASE = 0x0100
;	.ENDIF
; 	.IFNDEF DMA0
;		.EQU DMA0 = 0x0110
;	.ENDIF
; 	.IFNDEF DMA1
;		.EQU DMA1 = 0x0120
;	.ENDIF
; 	.IFNDEF DMA2
;		.EQU DMA2 = 0x0130
;	.ENDIF
; 	.IFNDEF DMA3
;		.EQU DMA3 = 0x0140
;	.ENDIF


.set DISABLE	= (0b00<<2)
.set CH01		= (0b01<<2)
.set CH23		= (0b10<<2)
.set CH01CH23	= (0b11<<2)

.set RR0123		= (0b00<<0)
.set CH0RR123	= (0b01<<0)
.set CH01RR23	= (0b10<<0)
.set CH0123		= (0b11<<0)


.MACRO DMA_ENABLE ; @0 = DBUFMODE @1 = PRIMODE
	LDI R24, ((1<<7) | @0 | @1) 
	STS (DMA_BASE + 0x00), R24
.ENDMACRO

.MACRO DMA_GET_STATUS ; @0 = Register
	LDS @0, (DMA_BASE + 0x04)
.ENDMACRO

.MACRO DMA_CH_ENABLE ; @0 = DMA_CH
PUSH XL
PUSH XH
	.IF @0 == 0
		LDI XL, LOW(DMA0)
		LDI XH, HIGH(DMA0)
	.ENDIF
	.IF @0 == 1
		LDI XL, LOW(DMA1)
		LDI XH, HIGH(DMA1)
	.ENDIF
	.IF @0 == 2
		LDI XL, LOW(DMA2)
		LDI XH, HIGH(DMA2)
	.ENDIF
	.IF @0 == 3
		LDI XL, LOW(DMA3)
		LDI XH, HIGH(DMA3)
	.ENDIF

	LD R24, X
	LDI R23, 0b10000000
	EOR R24, R23
	ST X, R24 

POP XH
POP XL
.ENDMACRO


.MACRO DMA_CH_BURSTLEN ; @0 = DMA_CH  @1 = BURSTLEN
PUSH XL
PUSH XH
	.IF @0 == 0
		LDI XL, LOW(DMA0)
		LDI XH, HIGH(DMA0)
	.ENDIF
	.IF @0 == 1
		LDI XL, LOW(DMA1)
		LDI XH, HIGH(DMA1)
	.ENDIF
	.IF @0 == 2
		LDI XL, LOW(DMA2)
		LDI XH, HIGH(DMA2)
	.ENDIF
	.IF @0 == 3
		LDI XL, LOW(DMA3)
		LDI XH, HIGH(DMA3)
	.ENDIF

	LD R24, X
	LDI R23, 0b11111100

	AND R24, R23

	.IF @1 == 1
		LDI R23, (0b00<<0)
	.ENDIF
	.IF @1 == 2
		LDI R23, (0b01<<0)
	.ENDIF
	.IF @1 == 4
		LDI R23, (0b10<<0)
	.ENDIF
	.IF @1 == 8
		LDI R23, (0b11<<0)
	.ENDIF

	EOR R24, R23
	ST X, R24 
POP XH
POP XL
.ENDMACRO


.MACRO DMA_CH_TRFREQ ; @0 = DMA_CH
PUSH XL
PUSH XH
	.IF @0 == 0
		LDI XL, LOW(DMA0)
		LDI XH, HIGH(DMA0)
	.ENDIF
	.IF @0 == 1
		LDI XL, LOW(DMA1)
		LDI XH, HIGH(DMA1)
	.ENDIF
	.IF @0 == 2
		LDI XL, LOW(DMA2)
		LDI XH, HIGH(DMA2)
	.ENDIF
	.IF @0 == 3
		LDI XL, LOW(DMA3)
		LDI XH, HIGH(DMA3)
	.ENDIF

	LD R24, X
	LDI R23, (1<<4)
	EOR R24, R23
	ST X, R24
POP XH
POP XL
.ENDMACRO


.MACRO DMA_CH_REPEAT ; @0 = DMA_CH @1 = TRUE/FALSE
PUSH XL
PUSH XH
	.IF @0 == 0
		LDI XL, LOW(DMA0)
		LDI XH, HIGH(DMA0)
	.ENDIF
	.IF @0 == 1
		LDI XL, LOW(DMA1)
		LDI XH, HIGH(DMA1)
	.ENDIF
	.IF @0 == 2
		LDI XL, LOW(DMA2)
		LDI XH, HIGH(DMA2)
	.ENDIF
	.IF @0 == 3
		LDI XL, LOW(DMA3)
		LDI XH, HIGH(DMA3)
	.ENDIF

	LD R24, X
	LDI R23, 0b11011111
	AND R24, R23
	LDI R23, (@1<<5)
	EOR R24, R23
	ST X, R24
POP XH
POP XL
.ENDMACRO

.MACRO DMA_CH_SINGLE ; @0 = DMA_CH @1 = TRUE/FALSE
PUSH XL
PUSH XH
	.IF @0 == 0
		LDI XL, LOW(DMA0)
		LDI XH, HIGH(DMA0)
	.ENDIF
	.IF @0 == 1
		LDI XL, LOW(DMA1)
		LDI XH, HIGH(DMA1)
	.ENDIF
	.IF @0 == 2
		LDI XL, LOW(DMA2)
		LDI XH, HIGH(DMA2)
	.ENDIF
	.IF @0 == 3
		LDI XL, LOW(DMA3)
		LDI XH, HIGH(DMA3)
	.ENDIF

	LD R24, X
	LDI R23, 0b11011111
	AND R24, R23
	LDI R23, (@1<<2)
	EOR R24, R23
	ST X, R24
POP XH
POP XL
.ENDMACRO

.MACRO DMA_CH_RESET ; @0 = DMA_CH
PUSH XL
PUSH XH
	.IF @0 == 0
		LDI XL, LOW(DMA0)
		LDI XH, HIGH(DMA0)
	.ENDIF
	.IF @0 == 1
		LDI XL, LOW(DMA1)
		LDI XH, HIGH(DMA1)
	.ENDIF
	.IF @0 == 2
		LDI XL, LOW(DMA2)
		LDI XH, HIGH(DMA2)
	.ENDIF
	.IF @0 == 3
		LDI XL, LOW(DMA3)
		LDI XH, HIGH(DMA3)
	.ENDIF

	LD R24, X
	LDI R23, 0x00
	ST X, R23
	LDI R23, (1<<6)
	ST X, R24
POP XH
POP XL
.ENDMACRO

 .endif ; dma_include