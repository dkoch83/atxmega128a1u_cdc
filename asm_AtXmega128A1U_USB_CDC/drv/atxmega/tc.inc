;/*
;* tc.inc
;*
;* Time Counter (XMega)
;*
;*  Created: 20.02.2015 19:29:49
;*   Author: Dominik
;*/ 

.IFNDEF TC_INCLUDE
.SET TC_INCLUDE = 1
	.SET TC_CLK_OFF		= 0b0000
	.SET TC_CLK_DIV1	= 0b0001
	.SET TC_CLK_DIV2 	= 0b0010
	.SET TC_CLK_DIV4	= 0b0011
	.SET TC_CLK_DIV8	= 0b0100
	.SET TC_CLK_DIV64	= 0b0101
	.SET TC_CLK_DIV256	= 0b0110
	.SET TC_CLK_DIV1024	= 0b0111
	.SET TC_CLK_EVCH0	= 0b1000
	.SET TC_CLK_EVCH1	= 0b1001
	.SET TC_CLK_EVCH2	= 0b1010
	.SET TC_CLK_EVCH3	= 0b1011
	.SET TC_CLK_EVCH4	= 0b1100
	.SET TC_CLK_EVCH5	= 0b1101
	.SET TC_CLK_EVCH6	= 0b1110
	.SET TC_CLK_EVCH7	= 0b1111

	.IFNDEF TCC0_BASE
		.EQU TCC0_BASE = 0x0800
	.ENDIF
	.IFNDEF TCC1_BASE
		.EQU TCC1_BASE = 0x0840
	.ENDIF
	.IFNDEF TCD0_BASE
		.EQU TCD0_BASE = 0x0900
	.ENDIF
	.IFNDEF TCD1_BASE
		.EQU TCD1_BASE = 0x0940
	.ENDIF
	.IFNDEF TCE0_BASE
		.EQU TCE0_BASE = 0x0A00
	.ENDIF
	.IFNDEF TCE1_BASE
		.EQU TCE1_BASE = 0x0A40
	.ENDIF
	.IFNDEF TCF0_BASE
		.EQU TCF0_BASE = 0x0B00
	.ENDIF

	.IFNDEF TCC0_DISABLE
	TCC0_START: ; R16 = TC_CLK


	RET
	.ENDIF
	.IFNDEF TCC1_DISABLE
	


	.ENDIF

	.IFNDEF TCD0_DISABLE
	


	.ENDIF
	.IFNDEF TCD1_DISABLE
	


	.ENDIF

	.IFNDEF TCE0_DISABLE
	


	.ENDIF
	.IFNDEF TCE1_DISABLE
	


	.ENDIF

	.IFNDEF TCF0_DISABLE
	


	.ENDIF
.ENDIF