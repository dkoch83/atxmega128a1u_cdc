;/*
;* Power Management
;*
;* pr.inc
;*
;*  Created: 30.12.2014 01:23:18
;*   Author: Dominik
;*/ 

.IFNDEF PR_BASE
	.SET PR_BASE = 0x0070
.ENDIF

.SET PR_USB		= (1<<6)
.SET PR_AES		= (1<<4)
.SET PR_EBI		= (1<<3)
.SET PR_RTC		= (1<<2)
.SET PR_EVSYS	= (1<<1)
.SET PR_DMA		= (1<<0)

.SET PRP_DAC	= (1<<2)
.SET PRP_ADC	= (1<<1)
.SET PRP_AC		= (1<<0)

.SET PRP_TWI	= (1<<6)
.SET PRP_USART1	= (1<<5)
.SET PRP_USART0	= (1<<4)
.SET PRP_SPI	= (1<<3)
.SET PRP_HIRES	= (1<<2)
.SET PRP_TC1	= (1<<1)
.SET PRP_TC0	= (1<<0)

;PRGEN – General Power Reduction register
PRGEN_SET: ; R16 = VALUE
PUSH R16
PUSH R17
	LDS R17, PR_BASE+0
	OR R17, R16
	STS PR_BASE+0, R17
POP R17
POP R16
RET

PRGEN_UNSET: ; R16 = VALUE
PUSH R16
PUSH R17
	LDS R17, PR_BASE+0
	COM R16
	AND R17, R16
	STS PR_BASE+0, R17
POP R17
POP R16
RET

;PRPA/B – Power Reduction Port A/B register
PRGPA_SET: ; R16 = SET
PUSH R16
PUSH R17
	LDS R17, PR_BASE+1
	OR R17, R16
	STS PR_BASE+1, R17
POP R17
POP R16
RET

PRGPA_UNSET: ; R16 = SET
PUSH R16
PUSH R17
	LDS R17, PR_BASE+1
	COM R16
	AND R17, R16
	STS PR_BASE+1, R17
POP R17
POP R16
RET

PRGPB_SET: ; R16 = SET
PUSH R16
PUSH R17
	LDS R17, PR_BASE+2
	OR R17, R16
	STS PR_BASE+2, R17
POP R17
POP R16
RET

PRGPB_UNSET: ; R16 = SET
PUSH R16
PUSH R17
	LDS R17, PR_BASE+2
	COM R16
	AND R17, R16
	STS PR_BASE+2, R17
POP R17
POP R16
RET

;PRPC/D/E/F – Power Reduction Port C/D/E/F register
PRGPC_SET: ; R16 = SET
PUSH R16
PUSH R17
	LDS R17, PR_BASE+3
	OR R17, R16
	STS PR_BASE+3, R17
POP R17
POP R16
RET

PRGPC_UNSET: ; R16 = SET
PUSH R16
PUSH R17
	LDS R17, PR_BASE+3
	COM R16
	AND R17, R16
	STS PR_BASE+3, R17
POP R17
POP R16
RET

PRGPD_SET: ; R16 = SET
PUSH R16
PUSH R17
	LDS R17, PR_BASE+4
	OR R17, R16
	STS PR_BASE+4, R17
POP R17
POP R16
RET

PRGPD_UNSET: ; R16 = SET
PUSH R16
PUSH R17
	LDS R17, PR_BASE+4
	COM R16
	AND R17, R16
	STS PR_BASE+4, R17
POP R17
POP R16
RET

PRGPE_SET: ; R16 = SET
PUSH R16
PUSH R17
	LDS R17, PR_BASE+5
	OR R17, R16
	STS PR_BASE+5, R17
POP R17
POP R16
RET

PRGPE_UNSET: ; R16 = SET
PUSH R16
PUSH R17
	LDS R17, PR_BASE+5
	COM R16
	AND R17, R16
	STS PR_BASE+5, R17
POP R17
POP R16
RET

PRGPF_SET: ; R16 = SET
PUSH R16
PUSH R17
	LDS R17, PR_BASE+6
	OR R17, R16
	STS PR_BASE+6, R17
POP R17
POP R16
RET

PRGPF_UNSET: ; R16 = SET
PUSH R16
PUSH R17
	LDS R17, PR_BASE+6
	COM R16
	AND R17, R16
	STS PR_BASE+6, R17
POP R17
POP R16
RET