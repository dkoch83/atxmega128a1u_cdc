;/*
; * usb_config.inc
; *
; *  Created: 01.03.2016 21:10:48
; *   Author: Dominik Koch
; */ 

.SET USB_REMOTE_WAKEUP = 0

;CTRLA Config
.SET USB_STORE_FRAME_NUM	= 1
.SET USB_FIFO_ENABLE		= 0
.SET USB_ENABLE_FULL_SPEED	= 1
.SET USB_PULL_DURING_RESET	= 1

;Enable Interrupts
.SET USB_ENABLE_SOFIE		= 1
.SET USB_ENABLE_BUSEVIE		= 0
.SET USB_ENABLE_BUSERRIE	= 0
.SET USB_ENABLE_STALLIE		= 0


.SET USB_MAX_EPS = 2

.EQU EP0_SIZE	= 8
.EQU EP1_SIZE	= 8
.EQU EP2_SIZE	= 64
.EQU EP3_SIZE	= 64


;################  USB CDC #################
.SET USB_CDC_ENABLE				= 1

.SET USB_CDC_CONFIGURATION_NUM	= 0x01

.SET EP_CDC_D_SIZE				= 64
.SET EP_CDC_C_SIZE				= 8

.SET EP_CDC_C_IN				= 0x81
.SET EP_CDC_D_OUT				= 0x02
.SET EP_CDC_D_IN				= 0x82	

.SET CDC_DATA_SIZE				= 64
; CDC_DATA_POSL		LOW BYTE OF CDC_DATA_POS Pointer
; CDC_DATA_POSH		HIGH BYTE OF CDC_DATA_POS Pointer
; CDC_DATA			CDC_DATA Buffer