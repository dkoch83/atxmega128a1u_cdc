;/*
;* usb_ep.inc
;*
;*  Created: 10.01.2016 17:55:34
;*   Author: Dominik Koch
;*/ 

.ifndef USB_EPS_INCLUDE
.set USB_EPS_INCLUDE = 1

.ifndef USB_MAX_EPS
	.error "USB_MAX_EPS not set"
.endif

.DSEG
	.ORG 0x2000
	TC_EP_FREE:	.BYTE ((15-USB_MAX_EPS)*4)
	TC_EP_ALLOC:.BYTE (USB_MAX_EPS*4)
	TC_EP:		.BYTE 4
;------------------------------------------
	ENDPOINTS:
	EP0_OUT_STATUS:	 .BYTE 1
	EP0_OUT_CTRL:	 .BYTE 1
	EP0_OUT_CNTL:	 .BYTE 1
	EP0_OUT_CNTH:	 .BYTE 1
	EP0_OUT_DATAPTRL:.BYTE 1
	EP0_OUT_DATAPTRH:.BYTE 1
	EP0_OUT_AUXDATAL:.BYTE 1
	EP0_OUT_AUXDATAH:.BYTE 1
	EP0_IN_STATUS:	 .BYTE 1
	EP0_IN_CTRL:	 .BYTE 1
	EP0_IN_CNTL:	 .BYTE 1
	EP0_IN_CNTH:	 .BYTE 1
	EP0_IN_DATAPTRL: .BYTE 1
	EP0_IN_DATAPTRH: .BYTE 1
	EP0_IN_AUXDATAL: .BYTE 1
	EP0_IN_AUXDATAH: .BYTE 1
.IF USB_MAX_EPS > 0
	EP1_OUT_STATUS:	 .BYTE 1
	EP1_OUT_CTRL:	 .BYTE 1
	EP1_OUT_CNTL:	 .BYTE 1
	EP1_OUT_CNTH:	 .BYTE 1
	EP1_OUT_DATAPTRL:.BYTE 1
	EP1_OUT_DATAPTRH:.BYTE 1
	EP1_OUT_AUXDATAL:.BYTE 1
	EP1_OUT_AUXDATAH:.BYTE 1
	EP1_IN_STATUS:	 .BYTE 1
	EP1_IN_CTRL:	 .BYTE 1
	EP1_IN_CNTL:	 .BYTE 1
	EP1_IN_CNTH:	 .BYTE 1
	EP1_IN_DATAPTRL: .BYTE 1
	EP1_IN_DATAPTRH: .BYTE 1
	EP1_IN_AUXDATAL: .BYTE 1
	EP1_IN_AUXDATAH: .BYTE 1
.ENDIF
.IF USB_MAX_EPS > 1
	EP2_OUT_STATUS:	 .BYTE 1
	EP2_OUT_CTRL:	 .BYTE 1
	EP2_OUT_CNTL:	 .BYTE 1
	EP2_OUT_CNTH:	 .BYTE 1
	EP2_OUT_DATAPTRL:.BYTE 1
	EP2_OUT_DATAPTRH:.BYTE 1
	EP2_OUT_AUXDATAL:.BYTE 1
	EP2_OUT_AUXDATAH:.BYTE 1
	EP2_IN_STATUS:	 .BYTE 1
	EP2_IN_CTRL:	 .BYTE 1
	EP2_IN_CNTL:	 .BYTE 1
	EP2_IN_CNTH:	 .BYTE 1
	EP2_IN_DATAPTRL: .BYTE 1
	EP2_IN_DATAPTRH: .BYTE 1
	EP2_IN_AUXDATAL: .BYTE 1
	EP2_IN_AUXDATAH: .BYTE 1
.ENDIF
.IF USB_MAX_EPS > 2
	EP3_OUT_STATUS:	 .BYTE 1
	EP3_OUT_CTRL:	 .BYTE 1
	EP3_OUT_CNTL:	 .BYTE 1
	EP3_OUT_CNTH:	 .BYTE 1
	EP3_OUT_DATAPTRL:.BYTE 1
	EP3_OUT_DATAPTRH:.BYTE 1
	EP3_OUT_AUXDATAL:.BYTE 1
	EP3_OUT_AUXDATAH:.BYTE 1
	EP3_IN_STATUS:	 .BYTE 1
	EP3_IN_CTRL:	 .BYTE 1
	EP3_IN_CNTL:	 .BYTE 1
	EP3_IN_CNTH:	 .BYTE 1
	EP3_IN_DATAPTRL: .BYTE 1
	EP3_IN_DATAPTRH: .BYTE 1
	EP3_IN_AUXDATAL: .BYTE 1
	EP3_IN_AUXDATAH: .BYTE 1
.ENDIF
.IF USB_MAX_EPS > 3
	EP4_OUT_STATUS:	 .BYTE 1
	EP4_OUT_CTRL:	 .BYTE 1
	EP4_OUT_CNTL:	 .BYTE 1
	EP4_OUT_CNTH:	 .BYTE 1
	EP4_OUT_DATAPTRL:.BYTE 1
	EP4_OUT_DATAPTRH:.BYTE 1
	EP4_OUT_AUXDATAL:.BYTE 1
	EP4_OUT_AUXDATAH:.BYTE 1
	EP4_IN_STATUS:	 .BYTE 1
	EP4_IN_CTRL:	 .BYTE 1
	EP4_IN_CNTL:	 .BYTE 1
	EP4_IN_CNTH:	 .BYTE 1
	EP4_IN_DATAPTRL: .BYTE 1
	EP4_IN_DATAPTRH: .BYTE 1
	EP4_IN_AUXDATAL: .BYTE 1
	EP4_IN_AUXDATAH: .BYTE 1
.ENDIF
.IF USB_MAX_EPS > 4
	EP5_OUT_STATUS:	 .BYTE 1
	EP5_OUT_CTRL:	 .BYTE 1
	EP5_OUT_CNTL:	 .BYTE 1
	EP5_OUT_CNTH:	 .BYTE 1
	EP5_OUT_DATAPTRL:.BYTE 1
	EP5_OUT_DATAPTRH:.BYTE 1
	EP5_OUT_AUXDATAL:.BYTE 1
	EP5_OUT_AUXDATAH:.BYTE 1
	EP5_IN_STATUS:	 .BYTE 1
	EP5_IN_CTRL:	 .BYTE 1
	EP5_IN_CNTL:	 .BYTE 1
	EP5_IN_CNTH:	 .BYTE 1
	EP5_IN_DATAPTRL: .BYTE 1
	EP5_IN_DATAPTRH: .BYTE 1
	EP5_IN_AUXDATAL: .BYTE 1
	EP5_IN_AUXDATAH: .BYTE 1
.ENDIF
.IF USB_MAX_EPS > 5
	EP6_OUT_STATUS:	 .BYTE 1
	EP6_OUT_CTRL:	 .BYTE 1
	EP6_OUT_CNTL:	 .BYTE 1
	EP6_OUT_CNTH:	 .BYTE 1
	EP6_OUT_DATAPTRL:.BYTE 1
	EP6_OUT_DATAPTRH:.BYTE 1
	EP6_OUT_AUXDATAL:.BYTE 1
	EP6_OUT_AUXDATAH:.BYTE 1
	EP6_IN_STATUS:	 .BYTE 1
	EP6_IN_CTRL:	 .BYTE 1
	EP6_IN_CNTL:	 .BYTE 1
	EP6_IN_CNTH:	 .BYTE 1
	EP6_IN_DATAPTRL: .BYTE 1
	EP6_IN_DATAPTRH: .BYTE 1
	EP6_IN_AUXDATAL: .BYTE 1
	EP6_IN_AUXDATAH: .BYTE 1
.ENDIF
.IF USB_MAX_EPS > 6
	EP7_OUT_STATUS:	 .BYTE 1
	EP7_OUT_CTRL:	 .BYTE 1
	EP7_OUT_CNTL:	 .BYTE 1
	EP7_OUT_CNTH:	 .BYTE 1
	EP7_OUT_DATAPTRL:.BYTE 1
	EP7_OUT_DATAPTRH:.BYTE 1
	EP7_OUT_AUXDATAL:.BYTE 1
	EP7_OUT_AUXDATAH:.BYTE 1
	EP7_IN_STATUS:	 .BYTE 1
	EP7_IN_CTRL:	 .BYTE 1
	EP7_IN_CNTL:	 .BYTE 1
	EP7_IN_CNTH:	 .BYTE 1
	EP7_IN_DATAPTRL: .BYTE 1
	EP7_IN_DATAPTRH: .BYTE 1
	EP7_IN_AUXDATAL: .BYTE 1
	EP7_IN_AUXDATAH: .BYTE 1
.ENDIF
.IF USB_MAX_EPS > 7
	EP8_OUT_STATUS:	 .BYTE 1
	EP8_OUT_CTRL:	 .BYTE 1
	EP8_OUT_CNTL:	 .BYTE 1
	EP8_OUT_CNTH:	 .BYTE 1
	EP8_OUT_DATAPTRL:.BYTE 1
	EP8_OUT_DATAPTRH:.BYTE 1
	EP8_OUT_AUXDATAL:.BYTE 1
	EP8_OUT_AUXDATAH:.BYTE 1
	EP8_IN_STATUS:	 .BYTE 1
	EP8_IN_CTRL:	 .BYTE 1
	EP8_IN_CNTL:	 .BYTE 1
	EP8_IN_CNTH:	 .BYTE 1
	EP8_IN_DATAPTRL: .BYTE 1
	EP8_IN_DATAPTRH: .BYTE 1
	EP8_IN_AUXDATAL: .BYTE 1
	EP8_IN_AUXDATAH: .BYTE 1
.ENDIF
.IF USB_MAX_EPS > 8
	EP9_OUT_STATUS:	 .BYTE 1
	EP9_OUT_CTRL:	 .BYTE 1
	EP9_OUT_CNTL:	 .BYTE 1
	EP9_OUT_CNTH:	 .BYTE 1
	EP9_OUT_DATAPTRL:.BYTE 1
	EP9_OUT_DATAPTRH:.BYTE 1
	EP9_OUT_AUXDATAL:.BYTE 1
	EP9_OUT_AUXDATAH:.BYTE 1
	EP9_IN_STATUS:	 .BYTE 1
	EP9_IN_CTRL:	 .BYTE 1
	EP9_IN_CNTL:	 .BYTE 1
	EP9_IN_CNTH:	 .BYTE 1
	EP9_IN_DATAPTRL: .BYTE 1
	EP9_IN_DATAPTRH: .BYTE 1
	EP9_IN_AUXDATAL: .BYTE 1
	EP9_IN_AUXDATAH: .BYTE 1
.ENDIF
.IF USB_MAX_EPS > 9
	EP10_OUT_STATUS:	.BYTE 1
	EP10_OUT_CTRL:		.BYTE 1
	EP10_OUT_CNTL:		.BYTE 1
	EP10_OUT_CNTH:		.BYTE 1
	EP10_OUT_DATAPTRL:	.BYTE 1
	EP10_OUT_DATAPTRH:	.BYTE 1
	EP10_OUT_AUXDATAL:	.BYTE 1
	EP10_OUT_AUXDATAH:	.BYTE 1
	EP10_IN_STATUS:		.BYTE 1
	EP10_IN_CTRL:		.BYTE 1
	EP10_IN_CNTL:		.BYTE 1
	EP10_IN_CNTH:		.BYTE 1
	EP10_IN_DATAPTRL:	.BYTE 1
	EP10_IN_DATAPTRH:	.BYTE 1
	EP10_IN_AUXDATAL:	.BYTE 1
	EP10_IN_AUXDATAH:	.BYTE 1
.ENDIF
.IF USB_MAX_EPS > 10
	EP11_OUT_STATUS:	.BYTE 1
	EP11_OUT_CTRL:		.BYTE 1
	EP11_OUT_CNTL:		.BYTE 1
	EP11_OUT_CNTH:		.BYTE 1
	EP11_OUT_DATAPTRL:	.BYTE 1
	EP11_OUT_DATAPTRH:	.BYTE 1
	EP11_OUT_AUXDATAL:	.BYTE 1
	EP11_OUT_AUXDATAH:	.BYTE 1
	EP11_IN_STATUS:		.BYTE 1
	EP11_IN_CTRL:		.BYTE 1
	EP11_IN_CNTL:		.BYTE 1
	EP11_IN_CNTH:		.BYTE 1
	EP11_IN_DATAPTRL:	.BYTE 1
	EP11_IN_DATAPTRH:	.BYTE 1
	EP11_IN_AUXDATAL:	.BYTE 1
	EP11_IN_AUXDATAH:	.BYTE 1
.ENDIF
.IF USB_MAX_EPS > 11
	EP12_OUT_STATUS:	.BYTE 1
	EP12_OUT_CTRL:		.BYTE 1
	EP12_OUT_CNTL:		.BYTE 1
	EP12_OUT_CNTH:		.BYTE 1
	EP12_OUT_DATAPTRL:	.BYTE 1
	EP12_OUT_DATAPTRH:	.BYTE 1
	EP12_OUT_AUXDATAL:	.BYTE 1
	EP12_OUT_AUXDATAH:	.BYTE 1
	EP12_IN_STATUS:		.BYTE 1
	EP12_IN_CTRL:		.BYTE 1
	EP12_IN_CNTL:		.BYTE 1
	EP12_IN_CNTH:		.BYTE 1
	EP12_IN_DATAPTRL:	.BYTE 1
	EP12_IN_DATAPTRH:	.BYTE 1
	EP12_IN_AUXDATAL:	.BYTE 1
	EP12_IN_AUXDATAH:	.BYTE 1
.ENDIF
.IF USB_MAX_EPS > 12
	EP13_OUT_STATUS:	.BYTE 1
	EP13_OUT_CTRL:		.BYTE 1
	EP13_OUT_CNTL:		.BYTE 1
	EP13_OUT_CNTH:		.BYTE 1
	EP13_OUT_DATAPTRL:	.BYTE 1
	EP13_OUT_DATAPTRH:	.BYTE 1
	EP13_OUT_AUXDATAL:	.BYTE 1
	EP13_OUT_AUXDATAH:	.BYTE 1
	EP13_IN_STATUS:		.BYTE 1
	EP13_IN_CTRL:		.BYTE 1
	EP13_IN_CNTL:		.BYTE 1
	EP13_IN_CNTH:		.BYTE 1
	EP13_IN_DATAPTRL:	.BYTE 1
	EP13_IN_DATAPTRH:	.BYTE 1
	EP13_IN_AUXDATAL:	.BYTE 1
	EP13_IN_AUXDATAH:	.BYTE 1
.ENDIF
.IF USB_MAX_EPS > 13
	EP14_OUT_STATUS:	.BYTE 1
	EP14_OUT_CTRL:		.BYTE 1
	EP14_OUT_CNTL:		.BYTE 1
	EP14_OUT_CNTH:		.BYTE 1
	EP14_OUT_DATAPTRL:	.BYTE 1
	EP14_OUT_DATAPTRH:	.BYTE 1
	EP14_OUT_AUXDATAL:	.BYTE 1
	EP14_OUT_AUXDATAH:	.BYTE 1
	EP14_IN_STATUS:		.BYTE 1
	EP14_IN_CTRL:		.BYTE 1
	EP14_IN_CNTL:		.BYTE 1
	EP14_IN_CNTH:		.BYTE 1
	EP14_IN_DATAPTRL:	.BYTE 1
	EP14_IN_DATAPTRH:	.BYTE 1
	EP14_IN_AUXDATAL:	.BYTE 1
	EP14_IN_AUXDATAH:	.BYTE 1
.ENDIF
.IF USB_MAX_EPS > 14
	EP15_OUT_STATUS:	.BYTE 1
	EP15_OUT_CTRL:		.BYTE 1
	EP15_OUT_CNTL:		.BYTE 1
	EP15_OUT_CNTH:		.BYTE 1
	EP15_OUT_DATAPTRL:	.BYTE 1
	EP15_OUT_DATAPTRH:	.BYTE 1
	EP15_OUT_AUXDATAL:	.BYTE 1
	EP15_OUT_AUXDATAH:	.BYTE 1
	EP15_IN_STATUS:		.BYTE 1
	EP15_IN_CTRL:		.BYTE 1
	EP15_IN_CNTL:		.BYTE 1
	EP15_IN_CNTH:		.BYTE 1
	EP15_IN_DATAPTRL:	.BYTE 1
	EP15_IN_DATAPTRH:	.BYTE 1
	EP15_IN_AUXDATAL:	.BYTE 1
	EP15_IN_AUXDATAH:	.BYTE 1
.ENDIF
;--------------------------------------
	USB_FRAMENUML:	 .BYTE 1
	USB_FRAMENUMH:	 .BYTE 1


USB_EP_SETUP_BUFFER:
	bmRequestType:	.BYTE 1
	bRequest:		.BYTE 1
	wValueL:		.BYTE 1
	wValueH:		.BYTE 1
	wIndexL:		.BYTE 1
	wIndexH:		.BYTE 1
	wLengthL:		.BYTE 1
	wLengthH:		.BYTE 1
USB_EP_SETUP_BUFFER_END:

USB_CONFIG: .BYTE 1

USB_INTERF_ALT_CONF:
	USB_INTERF00_ALT_CONF: .BYTE 1
	USB_INTERF01_ALT_CONF: .BYTE 1
	USB_INTERF02_ALT_CONF: .BYTE 1
USB_INTERF_ALT_CONF_END:

EP0_BUFFER:
	.BYTE EP0_SIZE
EP0_BUFFER_END:

EP0_BUFFER_START:  .BYTE 2
EP1_BUFFER_START:  .BYTE 2
EP2_BUFFER_START:  .BYTE 2
EP3_BUFFER_START:  .BYTE 2
EP4_BUFFER_START:  .BYTE 2
EP5_BUFFER_START:  .BYTE 2
EP6_BUFFER_START:  .BYTE 2
EP7_BUFFER_START:  .BYTE 2
EP8_BUFFER_START:  .BYTE 2
EP9_BUFFER_START:  .BYTE 2
EP10_BUFFER_START: .BYTE 2
EP11_BUFFER_START: .BYTE 2
EP12_BUFFER_START: .BYTE 2
EP13_BUFFER_START: .BYTE 2
EP14_BUFFER_START: .BYTE 2
EP15_BUFFER_START: .BYTE 2

.IF USB_CDC_ENABLE == 1
	CDC_LINE_CODING:
		dwDTERate:		.BYTE 4
		bCharFormat:	.BYTE 1
		bParityType:	.BYTE 1
		bDataBits:		.BYTE 1
	CDC_LINE_CODING_END:
	CDC_LINE_TMP:		.BYTE 1
	
	CDC_STATUS: .BYTE 1
	.SET CDC_TX_bp = 0
	.SET CDC_TX_bm = 0x01
	.SET CDC_RX_bp = 1
	.SET CDC_RX_bm = 0x02
	.SET CDC_ECHO_DISABLE_bp = 2
	.SET CDC_ECHO_DISABLE_bm = 0x04

	CDC_OUT_BUFFER:
		.BYTE EP_CDC_D_SIZE
	CDC_OUT_BUFFER_END:

	CDC_DATA_POS:
		CDC_DATA_POSL: .BYTE 1
		CDC_DATA_POSH: .BYTE 1
	CDC_DATA:
		.BYTE CDC_DATA_SIZE
	CDC_DATA_END:
.ENDIF

.CSEG
.endif