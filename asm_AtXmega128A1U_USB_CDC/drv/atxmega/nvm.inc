;/*
;* nvm.inc
;*
;*  Created: 22.02.2015 18:36:41
;*   Author: Dominik
;*/ 

;.IFNDEF NVM_BASE
;	.EQU NVM_BASE = 0x01C0
;.ENDIF

.SET NVM_CMD_NO_OPERATION			= 0x00

;Flash Page Buffer
.SET NVM_CMD_LOAD_FLASH_BUFFER		= 0x23
.SET NVM_CMD_ERASE_FLASH_BUFFER		= 0x26

;Flash
.SET NVM_CMD_ERASE_FLASH_PAGE		= 0x2B
.SET NVM_CMD_WRITE_FLASH_PAGE       = 0x2E
.SET NVM_CMD_ERASE_WRITE_FLASH_PAGE = 0x2F
.SET NVM_CMD_FLASH_RANGE_CRC        = 0x3A

;Application Section
.SET NVM_CMD_ERASE_APP				= 0x20
.SET NVM_CMD_ERASE_APP_PAGE         = 0x22
.SET NVM_CMD_WRITE_APP_PAGE         = 0x24
.SET NVM_CMD_ERASE_WRITE_APP_PAGE   = 0x25
.SET NVM_CMD_APP_CRC                = 0x38

;Boot Loader Section
.SET NVM_CMD_ERASE_BOOT_PAGE		= 0x2A
.SET NVM_CMD_WRITE_BOOT_PAGE        = 0x2C
.SET NVM_CMD_ERASE_WRITE_BOOT_PAGE  = 0x2D
.SET NVM_CMD_BOOT_CRC               = 0x39

;User Signature Row
.SET NVM_CMD_READ_USER_SIG_ROW		= 0x01
.SET NVM_CMD_ERASE_USER_SIG_ROW     = 0x18
.SET NVM_CMD_WRITE_USER_SIG_ROW     = 0x1A

;Production Signature (Calibration)
.SET NVM_CMD_READ_CALIB_ROW			= 0x02


.SET NVM_PSR_RCOSC48M = 0x1C



NVM_READ_PSR: ; R16
PUSH R16
PUSH ZL
PUSH ZH
	CLR ZH
	MOV ZL, R16

	LDI R16, NVM_CMD_READ_CALIB_ROW
	STS NVM_BASE+0x0A, R16
	LPM

	LDI R16, NVM_CMD_NO_OPERATION
	STS NVM_BASE+0x0A, R16
POP ZH
POP ZL
POP R16
RET