;/*
;* pmic.inc
;*
;*  Created: 29.12.2014 17:20:09
;*   Author: Dominik
;*/ 



PMIC_RESET:
PUSH R24
	LDI R24, 0x00
	STS (PMIC_STATUS+1), R24
	STS (PMIC_STATUS+2), R24
POP R24
RET

PMIC_ENABLE_HILV:
PUSH R24
	LDS R24, (PMIC_STATUS+2)
	SBR R24, (1<<2)
	STS (PMIC_STATUS+2), R24
POP R24
RET

PMIC_ENABLE_MEDLV:
PUSH R24
	LDS R24, (PMIC_STATUS+2)
	SBR R24, (1<<1)
	STS (PMIC_STATUS+2), R24
POP R24
RET

PMIC_ENABLE_LOLV:
PUSH R24
	LDS R24, (PMIC_STATUS+2)
	SBR R24, (1<<0)
	STS (PMIC_STATUS+2), R24
POP R24
RET

PMIC_DISABLE_HILV:
PUSH R24
	LDS R24, (PMIC_STATUS+2)
	CBR R24, (1<<2)
	STS (PMIC_STATUS+2), R24
POP R24
RET

PMIC_DISABLE_MEDLV:
PUSH R24
	LDS R24, (PMIC_STATUS+2)
	CBR R24, (1<<1)
	STS (PMIC_STATUS+2), R24
POP R24
RET

PMIC_DISABLE_LOLV:
PUSH R24
	LDS R24, (PMIC_STATUS+2)
	CBR R24, (1<<0)
	STS (PMIC_STATUS+2), R24
POP R24
RET

PMIC_ENABLE_RR:
PUSH R24
	LDS R24, (PMIC_STATUS+2)
	SBR R24, (1<<7)
	STS (PMIC_STATUS+2), R24
POP R24
RET

PMIC_DISABLE_RR:
PUSH R24
	LDS R24, (PMIC_STATUS+2)
	CBR R24, (1<<7)
	STS (PMIC_STATUS+2), R24
POP R24
RET

PMIC_IVSEL:
PUSH R24
	LDS R24, (PMIC_STATUS+2)
	CBR R24, (1<<6)
	STS (PMIC_STATUS+2), R24
POP R24
RET

PMIC_IVUNSEL:
PUSH R24
	LDS R24, (PMIC_STATUS+2)
	CBR R24, (1<<7)
	STS (PMIC_STATUS+2), R24
POP R24
RET